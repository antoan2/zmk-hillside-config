/* -------------------------------------------------------------------------- */
/* 1) Shared hold-tap helpers                                                  */
/* -------------------------------------------------------------------------- */

#define HOLD_TAP_COMMON                                      \
                flavor = "tap-preferred";                          \
                tapping-term-ms = <200>;                            \
                quick-tap-ms = <125>;

/* -------------------------------------------------------------------------- */
/* 2) Mouse
/* -------------------------------------------------------------------------- */

ht_special_mouse: hold_tap_special_mouse {
        compatible = "zmk,behavior-hold-tap";
        #binding-cells = <2>;
        HOLD_TAP_COMMON
        bindings = <&mouse_layer_toggle &special_layer_once>;
};

#define MOU_ENTRY &ht_special_mouse 0 0


/* -------------------------------------------------------------------------- */
/* 3) Specials
/* -------------------------------------------------------------------------- */

#define DEFINE_ACCENT_HOLD_TAP(NAME, HOLD, TAP, LABEL)       \
                NAME: NAME {                                        \
                        compatible = "zmk,behavior-hold-tap";        \
                        #binding-cells = <2>;                          \
                        HOLD_TAP_COMMON                                \
                        bindings = <HOLD TAP>;                         \
                        label = LABEL;                                 \
                };


DEFINE_ACCENT_HOLD_TAP(ht_e_aigu, &special_e_aigu_maj, &special_e_aigu, "HOLD_TAP_E_AIGU")
DEFINE_ACCENT_HOLD_TAP(ht_e_grave, &special_e_grave_maj, &special_e_grave, "HOLD_TAP_E_GRAVE")
DEFINE_ACCENT_HOLD_TAP(ht_e_hat, &special_e_hat_maj, &special_e_hat, "HOLD_TAP_E_HAT")
DEFINE_ACCENT_HOLD_TAP(ht_e_trema, &special_e_trema_maj, &special_e_trema, "HOLD_TAP_E_TREMA")
DEFINE_ACCENT_HOLD_TAP(ht_a_grave, &special_a_grave_maj, &special_a_grave, "HOLD_TAP_A_GRAVE")
DEFINE_ACCENT_HOLD_TAP(ht_a_hat, &special_a_hat_maj, &special_a_hat, "HOLD_TAP_A_HAT")
DEFINE_ACCENT_HOLD_TAP(ht_u_grave, &special_u_grave_maj, &special_u_grave, "HOLD_TAP_U_GRAVE")
DEFINE_ACCENT_HOLD_TAP(ht_u_hat, &special_u_hat_maj, &special_u_hat, "HOLD_TAP_U_HAT")
DEFINE_ACCENT_HOLD_TAP(ht_o_hat, &special_o_hat_maj, &special_o_hat, "HOLD_TAP_O_HAT")
DEFINE_ACCENT_HOLD_TAP(ht_i_hat, &special_i_hat_maj, &special_i_hat, "HOLD_TAP_I_HAT")
DEFINE_ACCENT_HOLD_TAP(ht_c_cedilla, &special_c_cedilla_maj, &special_c_cedilla, "HOLD_TAP_C_CEDILLA")
DEFINE_ACCENT_HOLD_TAP(ht_oe, &special_oe_maj, &special_oe, "HOLD_TAP_OE")

#define ACC_E_AIGU &ht_e_aigu 0 0
#define ACC_E_GRAVE &ht_e_grave 0 0
#define ACC_E_HAT &ht_e_hat 0 0
#define ACC_E_TREMA &ht_e_trema 0 0
#define ACC_A_GRAVE &ht_a_grave 0 0
#define ACC_A_HAT &ht_a_hat 0 0
#define ACC_U_GRAVE &ht_u_grave 0 0
#define ACC_U_HAT &ht_u_hat 0 0
#define ACC_O_HAT &ht_o_hat 0 0
#define ACC_I_HAT &ht_i_hat 0 0

#define ACC_E_AIGU_TWICE &special_e_aigu_twice
#define ACC_C_CEDILLA &ht_c_cedilla 0 0
#define ACC_AIGU &special_aigu
#define ACC_GRAVE &special_grave
#define ACC_HAT &special_hat
#define ACC_OE &ht_oe 0 0
#define EURO_SIGN &special_euro
#define ACC_TREMA &special_trema


/* -------------------------------------------------------------------------- */
/* 4) Number/Fn                                                                */
/* -------------------------------------------------------------------------- */

ht_num_fn: hold_tap_num_fn {
        compatible = "zmk,behavior-hold-tap";
        #binding-cells = <2>;
        HOLD_TAP_COMMON
        bindings = <&kp &kp>;
        label = "HOLD_TAP_NUMBER_FN";
};

#define HT_NUM_FN(NUM, FN) &ht_num_fn FN NUM
#define HT_1_F1 HT_NUM_FN(NUMBER_1, F1)
#define HT_2_F2 HT_NUM_FN(NUMBER_2, F2)
#define HT_3_F3 HT_NUM_FN(NUMBER_3, F3)
#define HT_4_F4 HT_NUM_FN(NUMBER_4, F4)
#define HT_5_F5 HT_NUM_FN(NUMBER_5, F5)
#define HT_6_F6 HT_NUM_FN(NUMBER_6, F6)
#define HT_7_F7 HT_NUM_FN(NUMBER_7, F7)
#define HT_8_F8 HT_NUM_FN(NUMBER_8, F8)
#define HT_9_F9 HT_NUM_FN(NUMBER_9, F9)
